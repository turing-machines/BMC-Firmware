## tp2bmc/board/tp2bmc/turing-pi2.its
```
/* SPDX-License-Identifier: GPL-2.0+
 * Copyright (C) 2024 Sven Rademakers <sven@turingpi.com>
 */

/dts-v1/;

/ {
    description = "turingpi kernel with FDT blobs";
    #address-cells = <1>;

    images {
        kernel6_8 {
            description = "turingpi 6.8.12";
            data = /incbin/("./zImage");
            type = "kernel";
            arch = "arm";
            os = "linux";
            compression = "none";
            load = <0x41000000>;
            entry = <0x41000000>;
            hash-1 {
                algo = "sha1";
            };
        };

        fdt-v2.4.0 {
            description = "sun8i-t113s-turing-pi2-v2.4.0";
            data = /incbin/("./sun8i-t113s-turing-pi2-v2.4.dtb");
            type = "flat_dt";
            arch = "arm";
            compression = "none";
            load = <0x41800000>;
            hash-1 {
                algo = "sha1";
            };
        };

        fdt-v2.5.0 {
            description = "sun8i-t113s-turing-pi2-v2.5.0";
            data = /incbin/("./sun8i-t113s-turing-pi2-v2.5.dtb");
            type = "flat_dt";
            arch = "arm";
            compression = "none";
            load = <0x41800000>;
            hash-1 {
                algo = "sha1";
            };
        };

        fdt-v2.5.1 {
            description = "sun8i-t113s-turing-pi2-v2.5.1";
            data = /incbin/("./sun8i-t113s-turing-pi2-v2.5.1.dtb");
            type = "flat_dt";
            arch = "arm";
            compression = "none";
            load = <0x41800000>;
            hash-1 {
                algo = "sha1";
            };
        };

        fdt-locked {
            description = "sun8i-t113s-turing-pi2-locked";
            data = /incbin/("./sun8i-t113s-turing-pi2-locked.dtb");
            type = "flat_dt";
            arch = "arm";
            compression = "none";
            load = <0x41800000>;
            hash-1 {
                algo = "sha1";
            };
        };
    };

    configurations {
        default = "config-v2.4.0";

        config-v2.4.0 {
            description = "turing-pi v2.4 configuration";
            kernel = "kernel6_8";
            fdt = "fdt-v2.4.0";
            compatible = "turing,pi2", "allwinner,sun8i-t113s";
        };

        config-v2.5.0 {
            description = "turing-pi v2.5 configuration";
            kernel = "kernel6_8";
            fdt = "fdt-v2.5.0";
            compatible = "turing,pi2", "allwinner,sun8i-t113s";
        };

        config-v2.5.1 {
            description = "turing-pi v2.5.1 configuration";
            kernel = "kernel6_8";
            fdt = "fdt-v2.5.1";
            compatible = "turing,pi2", "allwinner,sun8i-t113s";
        };

        config-v2.5.2 {
            description = "turing-pi v2.5.2 configuration";
            kernel = "kernel6_8";
            fdt = "fdt-v2.5.1";
            compatible = "turing,pi2", "allwinner,sun8i-t113s";
        };

        locked {
            description = "disable write access for boot partition and eeprom";
            fdt = "fdt-locked";
        };
    };
};
```

## tp2bmc/board/tp2bmc/uboot_defconfig
```kconfig
CFG_SYS_I2C_DIRECT_BUS=y
CONFIG_ARCH_SUNXI=y
CONFIG_ARM=y
CONFIG_BLOBLIST=y
CONFIG_BLOBLIST_ADDR=0x41700000
CONFIG_BLOBLIST_FIXED=y
CONFIG_BUTTON=y
CONFIG_BUTTON_GPIO=y
CONFIG_CMD_BLOBLIST=y
CONFIG_CMD_I2C=y
CONFIG_CMD_LINK_LOCAL=y
CONFIG_CMD_MTD=y
CONFIG_CMD_TPI_INFO=y
CONFIG_CMD_UBI=y
CONFIG_CMD_USB_MASS_STORAGE=y
CONFIG_CONS_INDEX=4
CONFIG_DEFAULT_DEVICE_TREE="sun8i-t113s-turing-pi2-v2.4"
CONFIG_DEFAULT_ENV_FILE="$(BR2_EXTERNAL_TP2BMC_PATH)/board/tp2bmc/uboot.env"
CONFIG_DM_MTD=y
CONFIG_DM_USB_GADGET=y
CONFIG_DRAM_CLK=792
CONFIG_DRAM_SUNXI_ODT_EN=0
CONFIG_DRAM_SUNXI_TPR0=0x004a2195
CONFIG_DRAM_SUNXI_TPR11=0x340000
CONFIG_DRAM_SUNXI_TPR12=0x46
CONFIG_DRAM_SUNXI_TPR13=0x34000100
CONFIG_DRAM_ZQ=8092667
CONFIG_ENV_FAT_FILE="boot/uboot.env"
CONFIG_ENV_IS_IN_UBI=y
CONFIG_ENV_UBI_PART="ubi"
CONFIG_ENV_UBI_VOLUME="uboot-env"
CONFIG_ENV_VARS_UBOOT_RUNTIME_CONFIG=y
CONFIG_FASTBOOT_OEM_RUN=y
CONFIG_FS_EROFS=y
CONFIG_I2C2_ENABLE=y
CONFIG_I2C_EEPROM=y
CONFIG_IDENT_STRING=" Turing Machines, Inc."
CONFIG_IPV6=y
CONFIG_LED=y
CONFIG_LED_GPIO=y
CONFIG_LTO=y
CONFIG_MACH_SUN8I_R528=y
CONFIG_MISC=y
CONFIG_MTD=y
CONFIG_MTD_SPI_NAND=y
CONFIG_NETCONSOLE=y
CONFIG_PHY_REALTEK=y
CONFIG_SPI=y
CONFIG_SPL=y
CONFIG_SPL_BLOBLIST=y
CONFIG_SPL_BLOBLIST_FIXED=y
CONFIG_SPL_I2C=y
CONFIG_SPL_SERIAL=y
CONFIG_SPL_SPI_SUNXI=y
CONFIG_SPL_SPI_SUNXI_NAND=y
CONFIG_SPL_SPI_SUNXI_NAND_ASSUMED_PAGESIZE=0x800
CONFIG_SPL_SYS_I2C_LEGACY=y
CONFIG_SUN8I_EMAC=y
CONFIG_SUNXI_MINIMUM_DRAM_MB=128
CONFIG_SYS_I2C_EEPROM_ADDR=0x50
CONFIG_SYS_I2C_MVTWSI=y
CONFIG_TARGET_TURINGPI2=y
CONFIG_USB_FUNCTION_ACM=y
CONFIG_USB_MUSB_GADGET=y
CONFIG_USE_DEFAULT_ENV_FILE=y
CONFIG_VERSION_VARIABLE=y
```

## tp2bmc/configs/tp2bmc_defconfig
```kconfig
# Architecture
BR2_arm=y
BR2_cortex_a7=y
BR2_ARM_EABI=y

# System
BR2_TARGET_GENERIC_HOSTNAME="turingpi"
BR2_TARGET_GENERIC_ISSUE="Welcome to Turing Pi"
BR2_TARGET_GENERIC_ROOT_PASSWD="turing"
BR2_TARGET_GENERIC_GETTY_PORT="ttyS3"
BR2_TARGET_GENERIC_GETTY_BAUDRATE_115200=y
BR2_SYSTEM_DHCP="eth0"
BR2_INIT_SYSV=y
BR2_TARGET_TZ_INFO=y
BR2_TOOLCHAIN_BUILDROOT_CXX=y
BR2_SVN="svn"
BR2_CCACHE=y
BR2_RELRO_NONE=y

# Kernel
BR2_LINUX_KERNEL=y
BR2_LINUX_KERNEL_PATCH="$(BR2_EXTERNAL_TP2BMC_PATH)/patches/linux"
BR2_LINUX_KERNEL_USE_CUSTOM_CONFIG=y
BR2_LINUX_KERNEL_CUSTOM_CONFIG_FILE="$(BR2_EXTERNAL_TP2BMC_PATH)/board/tp2bmc/linux_defconfig"
BR2_LINUX_KERNEL_DTS_SUPPORT=y
BR2_LINUX_KERNEL_CUSTOM_DTS_PATH="$(BR2_EXTERNAL_TP2BMC_PATH)/board/tp2bmc/sun8i-t113s-turingmachines-tp2-bmc.dts"
BR2_LINUX_KERNEL_DTB_KEEP_DIRNAME=y
BR2_LINUX_KERNEL_INSTALL_TARGET=y
BR2_LINUX_KERNEL_NEEDS_HOST_OPENSSL=y
BR2_LINUX_KERNEL_NEEDS_HOST_LIBELF=y
BR2_KERNEL_HEADERS_AS_KERNEL=y

# Filesystem
BR2_TARGET_ROOTFS_EROFS=y
BR2_TARGET_ROOTFS_EROFS_LZ4HC=y
BR2_TARGET_ROOTFS_TAR_GZIP=y
BR2_ROOTFS_DEVICE_CREATION_DYNAMIC_MDEV=y
BR2_ROOTFS_OVERLAY="$(BR2_EXTERNAL_TP2BMC_PATH)/board/tp2bmc/overlay"
BR2_ROOTFS_POST_BUILD_SCRIPT="$(BR2_EXTERNAL_TP2BMC_PATH)/board/tp2bmc/post_build.sh"
BR2_ROOTFS_POST_IMAGE_SCRIPT="$(BR2_EXTERNAL_TP2BMC_PATH)/board/tp2bmc/post_image.sh"

# Bootloader
BR2_TARGET_UBOOT=y
BR2_TARGET_UBOOT_BUILD_SYSTEM_KCONFIG=y
BR2_TARGET_UBOOT_CUSTOM_GIT=y
BR2_TARGET_UBOOT_CUSTOM_REPO_URL="https://source.denx.de/u-boot/u-boot.git"
BR2_TARGET_UBOOT_CUSTOM_REPO_VERSION="v2024.01-rc1"
BR2_TARGET_UBOOT_PATCH="$(BR2_EXTERNAL_TP2BMC_PATH)/patches/uboot"
BR2_TARGET_UBOOT_USE_CUSTOM_CONFIG=y
BR2_TARGET_UBOOT_CUSTOM_CONFIG_FILE="$(BR2_EXTERNAL_TP2BMC_PATH)/board/tp2bmc/uboot_defconfig"
BR2_TARGET_UBOOT_NEEDS_DTC=y
BR2_TARGET_UBOOT_NEEDS_PYLIBFDT=y
BR2_TARGET_UBOOT_NEEDS_OPENSSL=y
BR2_TARGET_UBOOT_FORMAT_CUSTOM=y
BR2_TARGET_UBOOT_FORMAT_CUSTOM_NAME="u-boot-sunxi-with-spl.bin"
BR2_TARGET_UBOOT_CUSTOM_DTS_PATH="$(BR2_EXTERNAL_TP2BMC_PATH)/board/tp2bmc/sun8i-t113s-turingmachines-tp2-bmc.dts"

# Host packages
BR2_PACKAGE_HOST_DOSFSTOOLS=y
BR2_PACKAGE_HOST_GENEXT2FS=y
BR2_PACKAGE_HOST_GENIMAGE=y
BR2_PACKAGE_HOST_MKPASSWD=y
BR2_PACKAGE_HOST_MTD=y
BR2_PACKAGE_HOST_MTOOLS=y
BR2_PACKAGE_HOST_UBOOT_TOOLS=y

# Packages
BR2_PACKAGE_AVAHI_DAEMON=y
BR2_PACKAGE_AVAHI=y
BR2_PACKAGE_BASH=y
BR2_PACKAGE_CA_CERTIFICATES=y
BR2_PACKAGE_CHRONY=y
BR2_PACKAGE_COLLECTD_CURL=y
BR2_PACKAGE_COLLECTD=y
BR2_PACKAGE_DOSFSTOOLS_FSCK_FAT=y
BR2_PACKAGE_DOSFSTOOLS_MKFS_FAT=y
BR2_PACKAGE_DOSFSTOOLS=y
BR2_PACKAGE_E2FSPROGS=y
BR2_PACKAGE_E2FSPROGS=y
BR2_PACKAGE_EVTEST=y
BR2_PACKAGE_F2FS_TOOLS=y
BR2_PACKAGE_GPTFDISK_SGDISK=y
BR2_PACKAGE_GPTFDISK=y
BR2_PACKAGE_HTOP=y
BR2_PACKAGE_I2C_TOOLS=y
BR2_PACKAGE_LIBAIO=y
BR2_PACKAGE_LIBCURL_CURL=y
BR2_PACKAGE_LIBCURL=y
BR2_PACKAGE_LIBEVENT=y
BR2_PACKAGE_LIBGPIOD=y
BR2_PACKAGE_LIBGPIOD_TOOLS=y
BR2_PACKAGE_LIBOPENSSL_BIN=y
BR2_PACKAGE_LIBOPENSSL=y
BR2_PACKAGE_LIBTIRPC=y
BR2_PACKAGE_LIBUBOOTENV=y
BR2_PACKAGE_MTD_MKFSUBIFS=y
BR2_PACKAGE_MTD_MTDPART=y
BR2_PACKAGE_MTD_UBIFS_UTILS=y
BR2_PACKAGE_MTD=y
BR2_PACKAGE_NANO=y
BR2_PACKAGE_NSS_MDNS=y
BR2_PACKAGE_OPENSSH=y
BR2_PACKAGE_OPENSSL=y
BR2_PACKAGE_PARTED=y
BR2_PACKAGE_PICOCOM=y
BR2_PACKAGE_START_STOP_DAEMON=y
BR2_PACKAGE_TREE=y
BR2_PACKAGE_UTIL_LINUX_BINARIES=y
BR2_PACKAGE_UTIL_LINUX_UUIDD=y

# Custom packages
BR2_PACKAGE_BMCD=y
BR2_PACKAGE_BMC_INSTALLER=y
BR2_PACKAGE_BMC_UI=y
BR2_PACKAGE_ROCKUSB=y
BR2_PACKAGE_TPI=y
BR2_PACKAGE_RASPBERRYPI_TARGET_USBBOOT=y
```

## tp2bmc/package/bmc/Config.in
```kconfig
config BR2_PACKAGE_BMC
    bool "bmc"
    depends on BR2_PACKAGE_TPI_RS
    depends on BR2_PACKAGE_CJSON
    help
        This is a bmc
```

## tp2bmc/package/bmc_installer/Config.in
```kconfig
config BR2_PACKAGE_BMC_INSTALLER
	bool bmc_installer
	depends on BR2_PACKAGE_HOST_RUSTC_TARGET_ARCH_SUPPORTS
	select BR2_PACKAGE_HOST_RUSTC
	help
	  This is only necessary if you're building the installation SD Card
	  image. It implements the actual writing of the images to flash.
```

## tp2bmc/package/bmcd/Config.in
```kconfig
config BR2_PACKAGE_BMCD
	bool "bmcd"
	depends on BR2_PACKAGE_HOST_RUSTC_TARGET_ARCH_SUPPORTS
    depends on BR2_PACKAGE_LIBOPENSSL_BIN

	select BR2_PACKAGE_HOST_RUSTC
	help
	  System management daemon for the Baseboard Management Controller (BMC)
```

## tp2bmc/package/ifupdown-ng/Config.in
```kconfig
config BR2_PACKAGE_IFUPDOWN_NG
	bool "ifupdown-ng"
	depends on BR2_USE_MMU # fork()
	depends on BR2_TOOLCHAIN_HEADERS_AT_LEAST_3_4 # iproute2
	depends on BR2_PACKAGE_BUSYBOX_SHOW_OTHERS
	select BR2_PACKAGE_LIBBSD if !BR2_TOOLCHAIN_USES_MUSL
	# runtime for ip binary
	select BR2_PACKAGE_IPROUTE2
	help
	  Network device manager that is largely compatible with Debian
	  ifupdown, BusyBox ifupdown and Cumulus Networks' ifupdown2.

	  https://github.com/ifupdown-ng/ifupdown-ng

comment "ifupdown-ng needs a toolchain w/ headers >= 3.4"
	depends on BR2_USE_MMU
	depends on !BR2_TOOLCHAIN_HEADERS_AT_LEAST_3_4
	depends on BR2_PACKAGE_BUSYBOX_SHOW_OTHERS
```

## tp2bmc/package/raspberrypi-target-usbboot/Config.in
```kconfig
config BR2_PACKAGE_RASPBERRYPI_TARGET_USBBOOT
	bool "raspberrypi-target-usbboot"
	depends on BR2_arm || BR2_aarch64
	depends on BR2_HOST_GCC_AT_LEAST_4_9 # libusb
	select BR2_PACKAGE_LIBUSB
	help
	  This package builds and install the "rpiboot" tool for the
	  target machine. This tool allows to boot the Broadcom BCM
	  processor used in the RaspberryPi to boot over USB, and have
	  it expose a USB mass storage device in order to reflash the
	  built-in storage of the RaspberryPi (useful for the eMMC
	  built into the Compute module).

	  https://github.com/raspberrypi/usbboot

comment "raspberrypi-target-usbboot needs a toolchain w/ host gcc >= 4.9"
	depends on BR2_arm || BR2_aarch64
	depends on !BR2_HOST_GCC_AT_LEAST_4_9
```

## tp2bmc/package/raspberrypi-usbboot/Config.in
```kconfig
config BR2_PACKAGE_RASPBERRYPI_USBBOOT
	bool "raspberrypi-usbboot"
	depends on BR2_arm || BR2_aarch64
	depends on BR2_TOOLCHAIN_HAS_THREADS # libusb
	depends on BR2_TOOLCHAIN_GCC_AT_LEAST_4_9 # libusb
	select BR2_PACKAGE_LIBUSB
	help
	  Raspberry Pi USB booting code

	  https://github.com/raspberrypi/usbboot

comment "raspberrypi-usbboot needs toolchain w/ threads, gcc >= 4.9"
	depends on BR2_arm || BR2_aarch64
	depends on !BR2_TOOLCHAIN_HAS_THREADS || \
	  !BR2_TOOLCHAIN_GCC_AT_LEAST_4_9
```

## tp2bmc/package/rockusb/Config.in
```kconfig
config BR2_PACKAGE_ROCKUSB
    bool "Rockusb driver"
    depends on BR2_LINUX_KERNEL
    help
        This is a kernel module that allows block device access to Rockchip
	devices speaking the Rockusb protocol.
```

## tp2bmc/package/tpi_rs/Config.in
```kconfig
config BR2_PACKAGE_TPI_RS
	bool "tpi_rs"
	depends on BR2_PACKAGE_HOST_RUSTC_TARGET_ARCH_SUPPORTS
	depends on BR2_PACKAGE_SQLITE
	select BR2_PACKAGE_HOST_RUSTC
	select BR2_PACKAGE_LIBUSB
	help
	  development of the rust version of the tp2
```
